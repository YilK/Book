#include "stm32f10x.h"

int main()
{
	//绿灯
//	//打开GPIOB端口的时钟 
//	*(unsigned int *) 0x40021018 |=((1)<<3);
//	
//	//配置ODR寄存器	(端口输出数据寄存器）											清零操作
//  *(unsigned int *)0x40010C0C &=~(1<<0);//0x40010C0C在编译器看来是一个立即数，如果要让编译器将其看做是一个地址，就必须进行强制类型转换
//	
//	//配置IO口为输出											置1操作
//	*(unsigned int *)0x40010C00 |=((1)<<(4*0));//(4*0) 4个为一组
	
	
//	蓝灯
//		//打开GPIOB端口时钟，置1开启，所以需要置1操作
//	*(unsigned int *) 0x40021018 |=(1<<3);
//	*(unsigned int *)0x40010C0C &=~(1<<1);//PB1设置为0 
//	//配置IO口为输出 
//	// 进行置1操作
//	*(unsigned int *)0x40010C00 |=((1)<<(4*1)); 
	
	
//	//红灯
////打开GPIOB端口的时钟  置1操作 将时钟开启
//	*(unsigned int *)0x40021018 |=(1<<3);
////配置ODR寄存器		置0操作
//	*(unsigned int *)0x40010C0C &=~(1<<5);
////配置IO为输出口
//	*(unsigned int *)0x40010C00 |=(1<<(4*5));
	

	while(1)
	{
		int j=0;
		*(unsigned int *) 0x40021018 |=((1)<<3);  //打开GPIOB端口时钟
		
		*(unsigned int *)0x40010C0C &=~(1<<0);	//绿灯口置0
		*(unsigned int *)0x40010C00 |=((1)<<(4*0));	//设置绿灯的IO口为输出。
		while(j<=1000000)
		{
			j++;
		}
		*(unsigned int *)0x40010C00 &=~((1)<<(4*0));//绿灯的IO口复位
		
		*(unsigned int *)0x40010C0C &=~(1<<1);
		*(unsigned int *)0x40010C00 |=((1)<<(4*1)); 
		
		while(j<=2000000)
		{
			j++;
		}
		*(unsigned int *)0x40010C00 &=~((1)<<(4*1));
		
		
		*(unsigned int *)0x40010C0C &=~(1<<5);
		*(unsigned int *)0x40010C00 |=(1<<(4*5));
		while(j<=3000000)
		{
			j++;
		}
		*(unsigned int *)0x40010C00 &=~(1<<(4*5));
	}
}
void SystemInit()
{
    //函数体为空，目的是为了骗过编译器不报错
}
